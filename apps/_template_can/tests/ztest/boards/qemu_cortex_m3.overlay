/* qemu: software loopback CAN controller as zephyr,canbus */
/ {
	chosen {
		zephyr,canbus = &can_loopback0;
	};

	can_loopback0: can_loopback0 {
		compatible = "zephyr,can-loopback";
		status = "okay";
	};
};
