## apps/_template_module/drivers/tally/Kconfig
```kconfig
config TALLY
	bool "Tally event counter (acme,tally)"
	default y
	depends on DT_HAS_ACME_TALLY_ENABLED
	help
	  Enabled automatically when the devicetree has an enabled acme,tally node.

config TALLY_INIT_PRIORITY
	int "Tally init priority"
	default 50
	depends on TALLY
```

## apps/_template_module/dts/bindings/acme,tally.yaml
```yaml
description: Event counter that calls back when a threshold is reached (example driver of a Zephyr module)

compatible: "acme,tally"

include: base.yaml

properties:
  threshold:
    type: int
    required: true
    description: Count at which the callback fires (once per crossing)
  initial:
    type: int
    default: 0
    description: Count after init and after tally_reset()
```

## apps/_template_module/tests/ztest/testcase.yaml
```yaml
# scripts/app ztest <module dir> [board]
tests:
  module.__name__.tally:
    tags: [ztest, driver, module]
    integration_platforms:
      - qemu_cortex_m3
    platform_allow:
      - qemu_cortex_m3
      - qemu_riscv32
```

## apps/_template_smf/tests/ztest/testcase.yaml
```yaml
# scripts/app ztest <app> [board]
tests:
  app.__name__.fsm:
    tags: [ztest, smf]
    integration_platforms:
      - qemu_cortex_m3
    platform_allow:
      - qemu_cortex_m3
      - qemu_riscv32
```

## apps/_template_workq/tests/ztest/testcase.yaml
```yaml
# scripts/app ztest <app> [board]
tests:
  app.__name__.sampler:
    tags: [ztest, workqueue]
    integration_platforms:
      - qemu_cortex_m3
    platform_allow:
      - qemu_cortex_m3
      - qemu_riscv32
```

## apps/_template_zbus/tests/ztest/testcase.yaml
```yaml
# scripts/app ztest <app> [board]
tests:
  app.__name__.bus:
    tags: [ztest, zbus]
    integration_platforms:
      - qemu_cortex_m3
    platform_allow:
      - qemu_cortex_m3
      - qemu_riscv32
```

## apps/_template_zig/tests/ztest/testcase.yaml
```yaml
# scripts/app ztest <app> [board]
tests:
  app.__name__.filter:
    tags: [ztest, zig]
    integration_platforms:
      - qemu_cortex_m3
    platform_allow:
      - qemu_cortex_m3
      - qemu_riscv32
```

## examples/zephyr/can-loopback/testcase.yaml
```yaml
# twister: scripts/app ztest can-loopback [board]
common:
  tags: [ztest, can]
  integration_platforms:
    - qemu_cortex_m3
  platform_allow:
    - qemu_cortex_m3
    - qemu_riscv32
tests:
  examples.can.loopback: {}
```

## examples/zephyr/input-keys/testcase.yaml
```yaml
# twister: scripts/app ztest input-keys [board]
common:
  tags: [ztest, input, gpio, emul]
  integration_platforms:
    - qemu_cortex_m3
  platform_allow:
    - qemu_cortex_m3
    - qemu_riscv32
tests:
  examples.input.keys: {}
```

## examples/zephyr/littlefs-flashsim/testcase.yaml
```yaml
# twister: scripts/app ztest littlefs-flashsim [board]
common:
  tags: [ztest, filesystem, littlefs, flash]
  integration_platforms:
    - qemu_cortex_m3
  platform_allow:
    - qemu_cortex_m3
    - qemu_riscv32
tests:
  examples.fs.littlefs_flashsim: {}
```

## examples/zephyr/log-backend/testcase.yaml
```yaml
# twister: scripts/app ztest log-backend [board]
common:
  tags: [ztest, logging]
  integration_platforms:
    - qemu_cortex_m3
  platform_allow:
    - qemu_cortex_m3
    - qemu_riscv32
tests:
  examples.logging.backend: {}
```
