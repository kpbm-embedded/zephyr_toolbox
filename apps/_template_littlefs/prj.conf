## CMakeLists.txt
```
# SPDX-License-Identifier: Apache-2.0
cmake_minimum_required(VERSION 3.20.0)
find_package(Zephyr REQUIRED HINTS $ENV{ZEPHYR_BASE})
project(__name__)

target_include_directories(app PRIVATE lib/datalog)
target_sources(app PRIVATE src/main.c lib/datalog/datalog.c)
```

## prj.conf
```kconfig
CONFIG_PRINTK=y
CONFIG_MAIN_STACK_SIZE=4096
CONFIG_FLASH=y
CONFIG_FLASH_MAP=y
CONFIG_FILE_SYSTEM=y
CONFIG_FILE_SYSTEM_LITTLEFS=y
```

## src/main.c
```c
#include <zephyr/kernel.h>
#include "datalog.h"

int main(void)
{
	for (int i = 0; i < 20; i++) {
		int err = datalog_append(i * 10);

		if (err) {
			printk("append failed: %d (is " DATALOG_DIR " mounted?)\n", err);
			return 0;
		}
		k_msleep(100);
	}
	printk("__name__: %d records, %u rotations\n", datalog_count(), datalog_rotations());
	return 0;
}
```
