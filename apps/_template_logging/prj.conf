## CMakeLists.txt
```
# SPDX-License-Identifier: Apache-2.0
cmake_minimum_required(VERSION 3.20.0)
find_package(Zephyr REQUIRED HINTS $ENV{ZEPHYR_BASE})
project(__name__)

target_include_directories(app PRIVATE lib/core)
target_sources(app PRIVATE src/main.c lib/core/core.c)
```

## Kconfig
```
mainmenu "__name__"

menu "Application"
# CONFIG_APP_CORE_LOG_LEVEL (0 off .. 4 dbg), default CONFIG_LOG_DEFAULT_LEVEL
module = APP_CORE
module-str = app_core
source "subsys/logging/Kconfig.template.log_config"
endmenu

source "Kconfig.zephyr"
```

## prj.conf
```kconfig
CONFIG_LOG=y
CONFIG_LOG_MODE_DEFERRED=y
CONFIG_LOG_BACKEND_UART=y
CONFIG_LOG_RUNTIME_FILTERING=y
CONFIG_APP_CORE_LOG_LEVEL_DBG=y
CONFIG_SHELL=y
CONFIG_LOG_CMDS=y
```

## src/main.c
```c
#include <zephyr/kernel.h>
#include <zephyr/logging/log.h>
#include "core.h"

LOG_MODULE_REGISTER(main, LOG_LEVEL_INF);

int main(void)
{
	const uint8_t good[] = {1, 2, 3, 6}, bad[] = {1, 2, 3, 7};

	LOG_INF("__name__ started");
	core_process(good, sizeof(good));
	core_process(bad, sizeof(bad));
	core_process(good, 1);
	return 0;
}
```
