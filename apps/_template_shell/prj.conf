## CMakeLists.txt
```
# SPDX-License-Identifier: Apache-2.0
cmake_minimum_required(VERSION 3.20.0)
find_package(Zephyr REQUIRED HINTS $ENV{ZEPHYR_BASE})
project(__name__)

target_include_directories(app PRIVATE lib/cmds)
target_sources(app PRIVATE src/main.c lib/cmds/cmds.c)
```

## prj.conf
```kconfig
CONFIG_PRINTK=y
CONFIG_SHELL=y
CONFIG_SHELL_BACKEND_SERIAL=y
CONFIG_SHELL_PROMPT_UART="uart:~$ "
```

## src/main.c
```c
#include <zephyr/kernel.h>

/* the shell runs in its own thread on the console UART; the commands are in lib/cmds */
int main(void)
{
	printk("__name__ ready: try 'app status'\n");
	return 0;
}
```
