## CMakeLists.txt
```
# SPDX-License-Identifier: Apache-2.0
# Application-SoC app template of 32_03_zephyr (copy with: scripts/app new <name> --board <board>).
cmake_minimum_required(VERSION 3.20.0)
# >>> mcu/clion: host unit tests, CMake profile "Host-Tests" (see README.md)
if(MCU_HOST_TESTS)
  project(_template_soc_host_tests C CXX)
  enable_testing()
  add_subdirectory(tests)
  return()
endif()
# <<< mcu/clion
# Out-of-tree boards/SoCs of this ID (ports/ is a Zephyr module): found relative to this app,
# so CLion and plain cmake work without extra options. REALPATH: also correct through symlinks.
# (an app outside apps/ gets ports/ from scripts/app, which exports ZEPHYR_EXTRA_MODULES)
get_filename_component(SOC_PORTS "${CMAKE_CURRENT_LIST_DIR}/../../ports" REALPATH)
if(EXISTS "${SOC_PORTS}/zephyr/module.yml")
  list(APPEND ZEPHYR_EXTRA_MODULES "${SOC_PORTS}")
endif()
find_package(Zephyr REQUIRED HINTS $ENV{ZEPHYR_BASE})
project(soc_app)

target_sources(app PRIVATE src/main.c)
```

## prj.conf
```kconfig
CONFIG_PRINTK=y
CONFIG_GPIO=y
CONFIG_SHELL=y
CONFIG_KERNEL_SHELL=y
```

## boards/luckfox_lyra.conf
```kconfig
# Example per-board Kconfig: a bigger shell history on the Lyra
CONFIG_SHELL_HISTORY_BUFFER=1024
```

## boards/nanopi_neo.overlay
```dts
/* Example: enable bank PG (e.g. for a button on PG11) in addition to PA (led0). */
&gpiog {
	status = "okay";
};
```

## src/main.c
```c
/*
 * Application-SoC template: console banner, uptime heartbeat, led0 blink when the board
 * has a led0 alias, and the Zephyr shell on the console UART (try: kernel uptime, app info).
 * SPDX-License-Identifier: Apache-2.0
 */
#include <zephyr/kernel.h>
#include <zephyr/drivers/gpio.h>
#include <zephyr/shell/shell.h>

#if DT_NODE_HAS_STATUS_OKAY(DT_ALIAS(led0))
static const struct gpio_dt_spec led = GPIO_DT_SPEC_GET(DT_ALIAS(led0), gpios);
#define HAVE_LED 1
#else
#define HAVE_LED 0
#endif

static int cmd_info(const struct shell *sh, size_t argc, char **argv)
{
	shell_print(sh, "board %s, %u Hz cycle counter, uptime %lld ms", CONFIG_BOARD_TARGET,
		    sys_clock_hw_cycles_per_sec(), k_uptime_get());
	return 0;
}
SHELL_CMD_REGISTER(info, NULL, "board and timer info", cmd_info);

int main(void)
{
	printk("app on %s\n", CONFIG_BOARD_TARGET);
#if HAVE_LED
	if (!gpio_is_ready_dt(&led) || gpio_pin_configure_dt(&led, GPIO_OUTPUT_INACTIVE) < 0) {
		printk("led0 not ready\n");
	}
#endif
	while (1) {
#if HAVE_LED
		gpio_pin_toggle_dt(&led);
#endif
		k_msleep(500);
	}
	return 0;
}
```
