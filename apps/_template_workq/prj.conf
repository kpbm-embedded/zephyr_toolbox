## CMakeLists.txt
```
# SPDX-License-Identifier: Apache-2.0
cmake_minimum_required(VERSION 3.20.0)
find_package(Zephyr REQUIRED HINTS $ENV{ZEPHYR_BASE})
project(__name__)

target_include_directories(app PRIVATE lib/sampler)
target_sources(app PRIVATE src/main.c lib/sampler/sampler.c)
```

## prj.conf
```kconfig
CONFIG_PRINTK=y
CONFIG_RING_BUFFER=y
CONFIG_SYS_CLOCK_TICKS_PER_SEC=1000
```

## src/main.c
```c
#include <zephyr/kernel.h>
#include "sampler.h"

static int32_t counter;
static int32_t read_counter(void)
{
	return counter++; /* replace with a sensor/ADC read */
}

int main(void)
{
	int32_t buf[16];

	sampler_start(50, read_counter);
	for (int round = 0; round < 5; round++) {
		k_msleep(200);
		size_t n = sampler_drain(buf, ARRAY_SIZE(buf));

		printk("round %d: %u samples, first %d, dropped %u\n", round, (unsigned int)n, n ? buf[0] : -1,
		       sampler_dropped());
	}
	sampler_stop();
	return 0;
}
```
