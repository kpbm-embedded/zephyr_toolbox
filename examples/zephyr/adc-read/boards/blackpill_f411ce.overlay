/* ADC1 channel 1 = PA1 (adc1_in1_pa1 is already set in blackpill_f411ce.dts). */
#include <zephyr/dt-bindings/adc/adc.h>
/ { zephyr,user { io-channels = <&adc1 1>; }; };
&adc1 {
	#address-cells = <1>;
	#size-cells = <0>;
	channel@1 {
		reg = <1>;
		zephyr,gain = "ADC_GAIN_1";
		zephyr,reference = "ADC_REF_INTERNAL";
		zephyr,acquisition-time = <ADC_ACQ_TIME_DEFAULT>;
		zephyr,resolution = <12>;
	};
};
