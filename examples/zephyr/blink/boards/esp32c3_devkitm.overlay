/* UNVERIFIED: ESP32-C3 SuperMini user LED on GPIO8; polarity differs between clones (this assumes active low). */
/ {
	aliases { led0 = &user_led; };
	leds {
		compatible = "gpio-leds";
		user_led: led_0 { gpios = <&gpio0 8 GPIO_ACTIVE_LOW>; };
	};
};
