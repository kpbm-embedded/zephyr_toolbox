## CMakeLists.txt
```
cmake_minimum_required(VERSION 3.20.0)
find_package(Zephyr REQUIRED HINTS $ENV{ZEPHYR_BASE})
project(dt_kconfig)
# app.overlay adds nodes of this app's own binding (dts/bindings/acme,thermostat.yaml: the app dir is a
# DTS_ROOT); Kconfig adds app options next to Zephyr's
target_sources(app PRIVATE src/zones.c src/test_config.c)
```

## Kconfig
```
# App options: set in prj.conf, a board's boards/<board>.conf, or -DCONFIG_...=... / twister extra_configs.
mainmenu "dt-kconfig example"

menu "Application"

config APP_SAMPLE_PERIOD_MS
	int "Sampling period (ms)"
	range 10 60000
	default 1000

config APP_VERBOSE
	bool "Print every sample"

config APP_ZONE_SERVER
	bool "Zone server (enabled when the devicetree has a zone_server node)"
	default $(dt_nodelabel_enabled,zone_server)
	help
	  Kconfig derived from devicetree: y only when third.overlay (or a board overlay) adds the node.

config APP_EXPECT_ZONES
	int "Zones the test expects (test-only)"
	default 2

endmenu

source "Kconfig.zephyr"
```

## prj.conf
```kconfig
CONFIG_ZTEST=y
# app option from ./Kconfig
CONFIG_APP_VERBOSE=y
```

## app.overlay
```dts
/* Two zones; status = "disabled" keeps a node out of the build (no struct, not counted). */
/ {
	zone_living: zone-living {
		compatible = "acme,thermostat";
		zone-name = "living";
		setpoint-mdeg = <21000>;
		mode = "heat";
	};

	zone_cellar: zone-cellar {
		compatible = "acme,thermostat";
		zone-name = "cellar";
		setpoint-mdeg = <14000>;
		hysteresis-mdeg = <1000>;
		mode = "cool";
	};

	zone_spare: zone-spare {
		compatible = "acme,thermostat";
		zone-name = "spare";
		setpoint-mdeg = <18000>;
		mode = "heat";
		status = "disabled";
	};
};
```

## third.overlay
```dts
/* extra overlay for the twister variant examples.dt_kconfig.overlay (EXTRA_DTC_OVERLAY_FILE) */
/ {
	zone_server: zone-server {
		compatible = "acme,thermostat";
		zone-name = "server";
		setpoint-mdeg = <24000>;
		hysteresis-mdeg = <250>;
		mode = "cool";
	};
};
```

## dts/bindings/acme,thermostat.yaml
```yaml
# Binding of this example (not part of Zephyr): one heating/cooling zone.
description: Thermostat zone with a set point and hysteresis

compatible: "acme,thermostat"

properties:
  setpoint-mdeg:
    type: int
    required: true
    description: Target temperature in milli-degrees Celsius
  hysteresis-mdeg:
    type: int
    default: 500
    description: Switching band around the set point
  mode:
    type: string
    required: true
    enum: ["heat", "cool"]
  zone-name:
    type: string
    required: true
```

## src/test_config.c
```c
#include <string.h>
#include <zephyr/ztest.h>
#include <zephyr/devicetree.h>
#include "zones.h"

ZTEST_SUITE(dt_kconfig, NULL, NULL, NULL, NULL, NULL);

static const struct zone *find(const char *name)
{
	for (int i = 0; i < zone_count; i++) {
		if (strcmp(zones[i].name, name) == 0) {
			return &zones[i];
		}
	}
	return NULL;
}

ZTEST(dt_kconfig, test_node_properties)
{
	/* the same values, straight from devicetree macros (all resolved at compile time) */
	BUILD_ASSERT(DT_PROP(DT_NODELABEL(zone_living), setpoint_mdeg) == 21000);
	BUILD_ASSERT(DT_PROP(DT_NODELABEL(zone_living), hysteresis_mdeg) == 500, "binding default");
	BUILD_ASSERT(DT_ENUM_IDX(DT_NODELABEL(zone_cellar), mode) == 1);
	zassert_true(DT_NODE_HAS_STATUS_OKAY(DT_NODELABEL(zone_living)));
	zassert_false(DT_NODE_HAS_STATUS_OKAY(DT_NODELABEL(zone_spare)));
}

ZTEST(dt_kconfig, test_table_from_devicetree)
{
	zassert_equal(zone_count, CONFIG_APP_EXPECT_ZONES);
	zassert_not_null(find("living"));
	zassert_not_null(find("cellar"));
	zassert_is_null(find("spare"), "disabled node must not be in the table");
	zassert_equal(find("cellar")->hysteresis, 1000);
	zassert_true(find("cellar")->cooling);
}

ZTEST(dt_kconfig, test_kconfig_values)
{
	zassert_true(IS_ENABLED(CONFIG_APP_VERBOSE), "set in prj.conf");
	zassert_true(CONFIG_APP_SAMPLE_PERIOD_MS == 1000 || CONFIG_APP_SAMPLE_PERIOD_MS == 250,
		     "1000 by default, 250 in the 'fast' twister variant");
}

ZTEST(dt_kconfig, test_kconfig_from_devicetree)
{
	/* APP_ZONE_SERVER follows $(dt_nodelabel_enabled,zone_server) */
	zassert_equal(IS_ENABLED(CONFIG_APP_ZONE_SERVER), find("server") != NULL);
}

ZTEST(dt_kconfig, test_heating_hysteresis)
{
	const struct zone *z = find("living"); /* 21.0 C +- 0.25 */
	bool on = false;

	on = zone_control(z, 20000, on);
	zassert_true(on);
	on = zone_control(z, 21100, on); /* inside the band: keep state */
	zassert_true(on);
	on = zone_control(z, 21300, on);
	zassert_false(on);
}

ZTEST(dt_kconfig, test_cooling_hysteresis)
{
	const struct zone *z = find("cellar"); /* 14.0 C +- 0.5, cooling */

	zassert_true(zone_control(z, 15000, false));
	zassert_true(zone_control(z, 14200, true));
	zassert_false(zone_control(z, 13400, true));
}
```

## src/zones.c
```c
#include <zephyr/devicetree.h>
#include "zones.h"

#define DT_DRV_COMPAT acme_thermostat

#define ZONE_ENTRY(inst)                                                                           \
	{                                                                                          \
		.name = DT_INST_PROP(inst, zone_name),                                             \
		.setpoint = DT_INST_PROP(inst, setpoint_mdeg),                                     \
		.hysteresis = DT_INST_PROP(inst, hysteresis_mdeg),                                 \
		.cooling = DT_INST_ENUM_IDX(inst, mode) == 1,                                      \
	},

const struct zone zones[] = {DT_INST_FOREACH_STATUS_OKAY(ZONE_ENTRY)};
const int zone_count = DT_NUM_INST_STATUS_OKAY(DT_DRV_COMPAT);

bool zone_control(const struct zone *z, int32_t mdeg, bool on)
{
	int32_t lo = z->setpoint - z->hysteresis / 2, hi = z->setpoint + z->hysteresis / 2;

	if (z->cooling) {
		return mdeg > hi ? true : (mdeg < lo ? false : on);
	}
	return mdeg < lo ? true : (mdeg > hi ? false : on);
}
```

## src/zones.h
```c
#ifndef ZONES_H
#define ZONES_H
#include <stdbool.h>
#include <stdint.h>

struct zone {
	const char *name;
	int32_t setpoint;
	int32_t hysteresis;
	bool cooling;
};

/* one entry per enabled acme,thermostat node, built at compile time from the devicetree */
extern const struct zone zones[];
extern const int zone_count;

/* two-point control: returns the new output state (heater/cooler on) for a measured temperature */
bool zone_control(const struct zone *z, int32_t mdeg, bool on);

#endif
```
