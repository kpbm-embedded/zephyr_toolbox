## CMakeLists.txt
```
cmake_minimum_required(VERSION 3.20.0)
find_package(Zephyr REQUIRED HINTS $ENV{ZEPHYR_BASE})
project(log_backend)
# a module that logs (src/sensor.c), a capture backend (src/capture_backend.c), the suite (src/test_log.c)
target_sources(app PRIVATE src/sensor.c src/capture_backend.c src/test_log.c)
```

## prj.conf
```kconfig
CONFIG_ZTEST=y
CONFIG_LOG=y
# immediate mode: a message reaches the backends inside the LOG_* call, so the test can check it at once
# (deferred mode, the default, hands messages to a log thread)
CONFIG_LOG_MODE_IMMEDIATE=y
CONFIG_LOG_RUNTIME_FILTERING=y
CONFIG_LOG_BACKEND_UART=y
CONFIG_LOG_DEFAULT_LEVEL=3
```

## src/capture_backend.c
```c
/* A log backend that formats messages into a RAM buffer (what a flash/BLE/network backend would send). */
#include <string.h>
#include <zephyr/logging/log_backend.h>
#include <zephyr/logging/log_output.h>
#include "capture_backend.h"

static char text[1024];
static size_t used;
static int lines;

static int out(uint8_t *data, size_t length, void *ctx)
{
	ARG_UNUSED(ctx);
	for (size_t i = 0; i < length && used < sizeof(text) - 1; i++) {
		text[used++] = (char)data[i];
		lines += data[i] == '\n';
	}
	text[used] = '\0';
	return (int)length;
}

static uint8_t out_buf[96];
LOG_OUTPUT_DEFINE(capture_output, out, out_buf, sizeof(out_buf));

static void process(const struct log_backend *const backend, union log_msg_generic *msg)
{
	ARG_UNUSED(backend);
	/* level tag, no timestamp, no colors: "<wrn> sensor: near limit 95" */
	log_output_msg_process(&capture_output, &msg->log, LOG_OUTPUT_FLAG_LEVEL);
}

static void panic(const struct log_backend *const backend)
{
	ARG_UNUSED(backend);
	log_output_flush(&capture_output);
}

static const struct log_backend_api api = {
	.process = process,
	.panic = panic,
};

LOG_BACKEND_DEFINE(capture_backend_ref, api, true);

const struct log_backend *capture_backend_get(void)
{
	return &capture_backend_ref;
}

void capture_clear(void)
{
	used = 0;
	lines = 0;
	text[0] = '\0';
}

const char *capture_text(void)
{
	return text;
}

int capture_lines(void)
{
	return lines;
}
```

## src/capture_backend.h
```c
#ifndef CAPTURE_BACKEND_H
#define CAPTURE_BACKEND_H
#include <zephyr/logging/log_backend.h>

/* LOG_BACKEND_DEFINE makes the backend static: reach it through this function */
const struct log_backend *capture_backend_get(void);
#define capture_backend (capture_backend_get())

void capture_clear(void);
const char *capture_text(void);
int capture_lines(void);

#endif
```

## src/sensor.c
```c
#include <zephyr/logging/log.h>
#include "sensor.h"

/* compile-time level of this module: INF. LOG_DBG below is compiled out (no code, no string). */
LOG_MODULE_REGISTER(sensor, LOG_LEVEL_INF);

int sensor_check(int32_t value, int32_t limit)
{
	LOG_DBG("value %d", value);
	if (value > limit) {
		LOG_ERR("over range %d > %d", value, limit);
		return -1;
	}
	if (value > limit - limit / 10) {
		LOG_WRN("near limit %d", value);
	} else {
		LOG_INF("ok %d", value);
	}
	return 0;
}

void sensor_dump(const uint8_t *frame, size_t len)
{
	LOG_HEXDUMP_INF(frame, len, "frame");
}
```

## src/sensor.h
```c
#ifndef SENSOR_H
#define SENSOR_H
#include <stdint.h>
#include <stddef.h>

/* checks a reading and logs: DBG every value, WRN near the limit, ERR above it; returns 0 if in range */
int sensor_check(int32_t value, int32_t limit);
void sensor_dump(const uint8_t *frame, size_t len);

#endif
```

## src/test_log.c
```c
#include <string.h>
#include <zephyr/ztest.h>
#include <zephyr/logging/log_ctrl.h>
#include "capture_backend.h"
#include "sensor.h"

static int16_t sensor_src;

static void *setup(void)
{
	sensor_src = (int16_t)log_source_id_get("sensor");
	zassert_true(sensor_src >= 0, "log source 'sensor' not found");
	return NULL;
}

static void before(void *f)
{
	ARG_UNUSED(f);
	log_backend_enable(capture_backend, NULL, LOG_LEVEL_DBG);
	log_filter_set(capture_backend, Z_LOG_LOCAL_DOMAIN_ID, sensor_src, LOG_LEVEL_DBG);
	capture_clear();
}

ZTEST_SUITE(log_backend, NULL, setup, before, NULL, NULL);

ZTEST(log_backend, test_levels_and_tags)
{
	zassert_equal(sensor_check(50, 100), 0);
	zassert_equal(sensor_check(95, 100), 0);
	zassert_equal(sensor_check(120, 100), -1);
	zassert_not_null(strstr(capture_text(), "<inf> sensor: ok 50"), "got: %s", capture_text());
	zassert_not_null(strstr(capture_text(), "<wrn> sensor: near limit 95"));
	zassert_not_null(strstr(capture_text(), "<err> sensor: over range 120 > 100"));
	zassert_equal(capture_lines(), 3);
}

ZTEST(log_backend, test_debug_is_compiled_out)
{
	sensor_check(1, 100);
	/* the module's compile-time level is INF: the runtime filter cannot bring LOG_DBG back */
	zassert_is_null(strstr(capture_text(), "value 1"));
}

ZTEST(log_backend, test_runtime_filter_per_backend)
{
	log_filter_set(capture_backend, Z_LOG_LOCAL_DOMAIN_ID, sensor_src, LOG_LEVEL_ERR);
	sensor_check(95, 100);  /* WRN: dropped for this backend only */
	sensor_check(150, 100); /* ERR: kept */
	zassert_is_null(strstr(capture_text(), "near limit"));
	zassert_not_null(strstr(capture_text(), "over range 150"));
	zassert_equal(capture_lines(), 1);
}

ZTEST(log_backend, test_hexdump)
{
	const uint8_t frame[] = {0xde, 0xad, 0xbe, 0xef};

	sensor_dump(frame, sizeof(frame));
	zassert_not_null(strstr(capture_text(), "frame"));
	zassert_not_null(strstr(capture_text(), "de ad be ef"), "got: %s", capture_text());
}

ZTEST(log_backend, test_backend_disable)
{
	log_backend_disable(capture_backend);
	sensor_check(150, 100);
	zassert_equal(capture_lines(), 0);
}
```
