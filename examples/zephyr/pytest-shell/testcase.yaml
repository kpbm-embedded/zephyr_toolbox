## examples/zephyr/sensor-emul/testcase.yaml
```yaml
# twister: scripts/app ztest sensor-emul [board]
common:
  tags: [ztest, sensor, emul, i2c]
  integration_platforms:
    - qemu_cortex_m3
  platform_allow:
    - qemu_cortex_m3
    - qemu_riscv32
tests:
  examples.sensor.emul: {}
```

## examples/zephyr/settings-nvs/testcase.yaml
```yaml
# twister: scripts/app ztest settings-nvs [board]
common:
  tags: [ztest, settings, nvs, flash]
  integration_platforms:
    - qemu_cortex_m3
  platform_allow:
    - qemu_cortex_m3
    - qemu_riscv32
tests:
  examples.settings.nvs: {}
```

## examples/zephyr/smf-pump/testcase.yaml
```yaml
# twister: scripts/app ztest smf-pump [board]
common:
  tags: [ztest, smf]
  integration_platforms:
    - qemu_cortex_m3
  platform_allow:
    - qemu_cortex_m3
    - qemu_riscv32
tests:
  examples.smf.pump: {}
```

## examples/zephyr/timer/sample.yaml
```yaml
# twister entries for the application-SoC boards (32_03_zephyr BOARDS.md); MCU targets: example.toml
sample:
  name: timer
tests:
  soc_ports.timer:
    build_only: true
    tags: soc_ports
    platform_allow:
      - nanopi_neo
      - nanopi_duo2
      - opi_zero2
      - mangopi_mq_r
      - luckfox_pico_mini
      - luckfox_lyra
      - milkv_duo
      - licheerv_nano
      - stm32mp135f_dk
      - k210_generic
      - canmv_k230
      - k230d_bpi_zero
  soc_ports.timer.qemu:
    tags: soc_ports
    platform_allow:
      - qemu_cortex_a9
      - qemu_cortex_a53
      - qemu_riscv64
    harness: console
    harness_config:
      type: one_line
      regex:
        - "periodic timer expiry 3 at"
```

## examples/zephyr/workq-timers/testcase.yaml
```yaml
# twister: scripts/app ztest workq-timers [board]
common:
  tags: [ztest, kernel, workqueue, timer]
  integration_platforms:
    - qemu_cortex_m3
  platform_allow:
    - qemu_cortex_m3
    - qemu_riscv32
tests:
  examples.kernel.workq_timers: {}
```

## examples/zephyr/zbus-pubsub/testcase.yaml
```yaml
# twister: scripts/app ztest zbus-pubsub [board]
common:
  tags: [ztest, zbus]
  integration_platforms:
    - qemu_cortex_m3
  platform_allow:
    - qemu_cortex_m3
    - qemu_riscv32
tests:
  examples.zbus.pubsub: {}
```

## examples/zephyr/ztest-fff/testcase.yaml
```yaml
# twister: scripts/app ztest ztest-fff [board]
common:
  tags: [ztest, fff]
  integration_platforms:
    - qemu_cortex_m3
  platform_allow:
    - qemu_cortex_m3
    - qemu_riscv32
tests:
  examples.ztest.fff: {}
```

## ports/boards/canaan/canmv_k230/board.yml
```yaml
board:
  name: canmv_k230
  full_name: CanMV-K230 class boards (K230, 01Studio/Canaan), CPU0
  vendor: canaan
  socs:
  - name: k230
```

## ports/boards/canaan/canmv_k230/canmv_k230_defconfig
```kconfig
# SPDX-License-Identifier: Apache-2.0
CONFIG_SERIAL=y
CONFIG_CONSOLE=y
CONFIG_UART_CONSOLE=y
CONFIG_XIP=n
CONFIG_UART_NS16550_ACCESS_WORD_ONLY=y
```

## ports/boards/canaan/k210_generic/Kconfig.k210_generic
```kconfig
# SPDX-License-Identifier: Apache-2.0
config BOARD_K210_GENERIC
	select SOC_K210
```

## ports/boards/canaan/k210_generic/board.yml
```yaml
board:
  name: k210_generic
  full_name: Kendryte K210 generic (Maix Bit/Dock/Go class)
  vendor: canaan
  socs:
  - name: k210
```

## ports/boards/canaan/k210_generic/k210_generic_defconfig
```kconfig
# SPDX-License-Identifier: Apache-2.0
CONFIG_SERIAL=y
CONFIG_CONSOLE=y
CONFIG_UART_CONSOLE=y
CONFIG_XIP=n
CONFIG_UART_SIFIVE_PORT_0=y
```

## ports/boards/canaan/k230d_bpi_zero/Kconfig.k230d_bpi_zero
```kconfig
# SPDX-License-Identifier: Apache-2.0
config BOARD_K230D_BPI_ZERO
	select SOC_K230
```

## ports/boards/canaan/k230d_bpi_zero/board.yml
```yaml
board:
  name: k230d_bpi_zero
  full_name: Banana Pi BPI-CanMV-K230D-Zero (K230D, 128 MB), CPU0
  vendor: canaan
  socs:
  - name: k230
```

## ports/boards/friendlyelec/nanopi_duo2/Kconfig.nanopi_duo2
```kconfig
# SPDX-License-Identifier: Apache-2.0
config BOARD_NANOPI_DUO2
	select SOC_SUN8I_H3
```

## ports/boards/friendlyelec/nanopi_duo2/board.yml
```yaml
board:
  name: nanopi_duo2
  full_name: FriendlyElec NanoPi Duo2 (H3)
  vendor: friendlyelec
  socs:
  - name: sun8i_h3
```

## ports/boards/friendlyelec/nanopi_neo/Kconfig.nanopi_neo
```kconfig
# SPDX-License-Identifier: Apache-2.0
config BOARD_NANOPI_NEO
	select SOC_SUN8I_H3
```

## ports/boards/friendlyelec/nanopi_neo/board.yml
```yaml
board:
  name: nanopi_neo
  full_name: FriendlyElec NanoPi NEO (H3)
  vendor: friendlyelec
  socs:
  - name: sun8i_h3
```
