## CMakeLists.txt
```
# C app + a no_std Rust static library over the C ABI (no zephyr-lang-rust, no bindgen): cargo builds
# rust/ for the board's Rust target, the library is linked into the Zephyr image, ztest calls it.
cmake_minimum_required(VERSION 3.20.0)
find_package(Zephyr REQUIRED HINTS $ENV{ZEPHYR_BASE})
project(rust_ffi)

# Rust target of the board: soft-float Cortex-M3 (qemu_cortex_m3) or RV32IMAC (qemu_riscv32)
if(CONFIG_RISCV)
  set(RUST_TARGET riscv32imac-unknown-none-elf)
elseif(CONFIG_CPU_CORTEX_M3)
  set(RUST_TARGET thumbv7m-none-eabi)
else()
  message(FATAL_ERROR "rust-ffi: no Rust target mapped for ${BOARD} (see CMakeLists.txt)")
endif()
find_program(CARGO cargo REQUIRED)   # scripts/app puts 32_17_embedded_rust's cargo on PATH
set(RUST_DIR ${CMAKE_CURRENT_SOURCE_DIR}/rust)
set(RUST_LIB ${CMAKE_BINARY_DIR}/rust/${RUST_TARGET}/release/libzffi.a)
add_custom_command(
  OUTPUT ${RUST_LIB}
  COMMAND ${CARGO} build --release --locked --target ${RUST_TARGET}
          --manifest-path ${RUST_DIR}/Cargo.toml --target-dir ${CMAKE_BINARY_DIR}/rust
  DEPENDS ${RUST_DIR}/Cargo.toml ${RUST_DIR}/Cargo.lock ${RUST_DIR}/src/lib.rs
  COMMENT "cargo build ${RUST_TARGET}"
  VERBATIM)
add_custom_target(zffi DEPENDS ${RUST_LIB})
add_dependencies(app zffi)
target_link_libraries(app PRIVATE ${RUST_LIB})

target_include_directories(app PRIVATE rust/include)
target_sources(app PRIVATE src/test_ffi.c)
```

## prj.conf
```kconfig
CONFIG_ZTEST=y
# float in printf-free code only; the Rust lib uses soft-float like the C code on these targets
```

## src/test_ffi.c
```c
#include <string.h>
#include <zephyr/kernel.h>
#include <zephyr/ztest.h>
#include "zffi.h"

/* called by the Rust panic handler */
FUNC_NORETURN void k_panic_from_rust(void)
{
	k_panic();
	CODE_UNREACHABLE;
}

ZTEST_SUITE(rust_ffi, NULL, NULL, NULL, NULL, NULL);

ZTEST(rust_ffi, test_crc16)
{
	const char *s = "123456789";

	zassert_equal(zffi_crc16((const uint8_t *)s, strlen(s)), 0x29b1);
	zassert_equal(zffi_crc16(NULL, 5), 0xffff, "NULL is handled on the Rust side");
}

ZTEST(rust_ffi, test_checked_add)
{
	uint32_t out = 7;

	zassert_true(zffi_checked_add(40, 2, &out));
	zassert_equal(out, 42);
	zassert_false(zffi_checked_add(UINT32_MAX, 1, &out));
	zassert_equal(out, 42, "untouched on overflow");
}

ZTEST(rust_ffi, test_pi_struct_shared_with_c)
{
	struct zffi_pi pi = {.kp = 2.0f, .ki = 1.0f, .out_min = -10.0f, .out_max = 10.0f};

	/* into a variable first: zassert_within() evaluates its arguments more than once */
	float out = zffi_pi_step(&pi, 1.0f, 0.5f);

	zassert_within(out, 2.5f, 0.001f);
	zassert_within(pi.integral, 0.5f, 0.001f, "Rust wrote the C struct");
	out = zffi_pi_step(&pi, 100.0f, 0.5f);
	zassert_equal(out, 10.0f, "clamped");
	zassert_within(pi.integral, 0.5f, 0.001f, "no wind-up while saturated");
}
```
