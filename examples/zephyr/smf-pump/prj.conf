## CMakeLists.txt
```
cmake_minimum_required(VERSION 3.20.0)
find_package(Zephyr REQUIRED HINTS $ENV{ZEPHYR_BASE})
project(smf_pump)
target_sources(app PRIVATE src/pump.c src/test_pump.c)
```

## prj.conf
```kconfig
CONFIG_ZTEST=y
CONFIG_SMF=y
# parent states (RUNNING handles stop/fault for its children) and initial transitions (RUNNING -> PRIME)
CONFIG_SMF_ANCESTOR_SUPPORT=y
CONFIG_SMF_INITIAL_TRANSITION=y
```

## src/pump.c
```c
/* Pump controller as a hierarchical state machine (SMF):
 *
 *   IDLE --start--> RUNNING{ PRIME --primed--> PUMP }   RUNNING --stop--> IDLE
 *                   RUNNING --fault--> FAULT --reset--> IDLE           IDLE --shutdown--> (terminate 42)
 *
 * PRIME and PUMP do not handle stop/fault themselves: they propagate the event to their parent RUNNING.
 */
#include <string.h>
#include "pump.h"

static const struct smf_state states[];

static void mark(void *o, const char *tok)
{
	struct pump *p = o;
	size_t n = strlen(p->trace);

	if (n + strlen(tok) + 2 < sizeof(p->trace)) {
		if (n) {
			p->trace[n++] = ' ';
		}
		strcpy(&p->trace[n], tok);
	}
}

static void idle_entry(void *o) { mark(o, "I>"); }
static void idle_exit(void *o) { mark(o, "I<"); }
static enum smf_state_result idle_run(void *o)
{
	struct pump *p = o;

	if (p->ev == EV_START) {
		smf_set_state(SMF_CTX(p), &states[RUNNING]);
	} else if (p->ev == EV_SHUTDOWN) {
		smf_set_terminate(SMF_CTX(p), 42);
	}
	return SMF_EVENT_HANDLED;
}

static void running_entry(void *o) { mark(o, "R>"); }
static void running_exit(void *o) { mark(o, "R<"); }
static enum smf_state_result running_run(void *o)
{
	struct pump *p = o;

	if (p->ev == EV_STOP) {
		smf_set_state(SMF_CTX(p), &states[IDLE]);
	} else if (p->ev == EV_FAULT) {
		smf_set_state(SMF_CTX(p), &states[FAULT]);
	}
	return SMF_EVENT_HANDLED;
}

static void prime_entry(void *o) { mark(o, "P>"); }
static void prime_exit(void *o) { mark(o, "P<"); }
static enum smf_state_result prime_run(void *o)
{
	struct pump *p = o;

	if (p->ev == EV_PRIMED) {
		smf_set_state(SMF_CTX(p), &states[PUMP]);
		return SMF_EVENT_HANDLED;
	}
	return SMF_EVENT_PROPAGATE; /* stop/fault: RUNNING decides */
}

static void pump_entry(void *o) { mark(o, "U>"); }
static void pump_exit(void *o) { mark(o, "U<"); }
static enum smf_state_result pump_run(void *o)
{
	struct pump *p = o;

	p->pump_ticks++;
	return SMF_EVENT_PROPAGATE;
}

static void fault_entry(void *o)
{
	struct pump *p = o;

	p->faults++;
	mark(o, "F>");
}
static void fault_exit(void *o) { mark(o, "F<"); }
static enum smf_state_result fault_run(void *o)
{
	struct pump *p = o;

	if (p->ev == EV_RESET) {
		smf_set_state(SMF_CTX(p), &states[IDLE]);
	}
	return SMF_EVENT_HANDLED;
}

static const struct smf_state states[] = {
	[IDLE] = SMF_CREATE_STATE(idle_entry, idle_run, idle_exit, NULL, NULL),
	[RUNNING] = SMF_CREATE_STATE(running_entry, running_run, running_exit, NULL, &states[PRIME]),
	[PRIME] = SMF_CREATE_STATE(prime_entry, prime_run, prime_exit, &states[RUNNING], NULL),
	[PUMP] = SMF_CREATE_STATE(pump_entry, pump_run, pump_exit, &states[RUNNING], NULL),
	[FAULT] = SMF_CREATE_STATE(fault_entry, fault_run, fault_exit, NULL, NULL),
};

void pump_init(struct pump *p)
{
	memset(p, 0, sizeof(*p));
	smf_set_initial(SMF_CTX(p), &states[IDLE]);
}

int32_t pump_event(struct pump *p, enum pump_event ev)
{
	p->ev = ev;
	return smf_run_state(SMF_CTX(p));
}

const struct smf_state *pump_state(enum pump_state s)
{
	return &states[s];
}
```

## src/pump.h
```c
#ifndef PUMP_H
#define PUMP_H
#include <zephyr/smf.h>

enum pump_event { EV_NONE, EV_START, EV_PRIMED, EV_STOP, EV_FAULT, EV_RESET, EV_SHUTDOWN };
enum pump_state { IDLE, RUNNING, PRIME, PUMP, FAULT };

struct pump {
	struct smf_ctx ctx; /* must be first: SMF_CTX() casts the object */
	enum pump_event ev;
	char trace[160];    /* "I> I< R> P> ..." entry (>) and exit (<) of each state, in order */
	int faults;
	int pump_ticks;
};

void pump_init(struct pump *p);
int32_t pump_event(struct pump *p, enum pump_event ev); /* != 0: machine terminated with that value */
const struct smf_state *pump_state(enum pump_state s);

#endif
```

## src/test_pump.c
```c
#include <string.h>
#include <zephyr/ztest.h>
#include "pump.h"

static struct pump p;

static void before(void *f)
{
	ARG_UNUSED(f);
	pump_init(&p);
}

ZTEST_SUITE(smf_pump, NULL, NULL, before, NULL, NULL);

static void clear_trace(void)
{
	p.trace[0] = '\0';
}

ZTEST(smf_pump, test_initial_state_entered)
{
	zassert_str_equal(p.trace, "I>");
	zassert_equal_ptr(p.ctx.current, pump_state(IDLE));
}

ZTEST(smf_pump, test_start_enters_parent_then_initial_child)
{
	clear_trace();
	zassert_equal(pump_event(&p, EV_START), 0);
	zassert_str_equal(p.trace, "I< R> P>");
	zassert_equal_ptr(p.ctx.current, pump_state(PRIME));
}

ZTEST(smf_pump, test_sibling_transition_keeps_parent)
{
	pump_event(&p, EV_START);
	clear_trace();
	pump_event(&p, EV_PRIMED);
	zassert_str_equal(p.trace, "P< U>", "RUNNING must not be exited: %s", p.trace);
}

ZTEST(smf_pump, test_child_propagates_stop_to_parent)
{
	pump_event(&p, EV_START);
	pump_event(&p, EV_PRIMED);
	clear_trace();
	pump_event(&p, EV_STOP);
	zassert_str_equal(p.trace, "U< R< I>");
	zassert_equal(p.pump_ticks, 1, "PUMP's run() saw the event before propagating it");
}

ZTEST(smf_pump, test_fault_and_reset)
{
	pump_event(&p, EV_START);
	clear_trace();
	pump_event(&p, EV_FAULT);
	zassert_str_equal(p.trace, "P< R< F>");
	zassert_equal(p.faults, 1);
	pump_event(&p, EV_START); /* ignored in FAULT */
	zassert_equal_ptr(p.ctx.current, pump_state(FAULT));
	pump_event(&p, EV_RESET);
	zassert_equal_ptr(p.ctx.current, pump_state(IDLE));
}

ZTEST(smf_pump, test_unhandled_event_changes_nothing)
{
	clear_trace();
	pump_event(&p, EV_PRIMED);
	zassert_str_equal(p.trace, "");
	zassert_equal_ptr(p.ctx.current, pump_state(IDLE));
}

ZTEST(smf_pump, test_terminate_returns_value)
{
	zassert_equal(pump_event(&p, EV_SHUTDOWN), 42);
}
```
