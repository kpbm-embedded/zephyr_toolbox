## CMakeLists.txt
```
cmake_minimum_required(VERSION 3.20.0)
find_package(Zephyr REQUIRED HINTS $ENV{ZEPHYR_BASE})
project(usb-cdc)
# sample_usbd_init_device() helper lives in the Zephyr tree (used read-only, not copied)
set(SAMPLE_USBD_DIR ${ZEPHYR_BASE}/samples/subsys/usb/common)
target_include_directories(app PRIVATE ${SAMPLE_USBD_DIR})
target_sources(app PRIVATE src/main.c ${SAMPLE_USBD_DIR}/sample_usbd_init.c)
```

## Kconfig
```
# Pulls in the sample USB device options (CONFIG_SAMPLE_USBD_*) from the Zephyr tree
source "$(ZEPHYR_BASE)/samples/subsys/usb/common/Kconfig.sample_usbd"

source "Kconfig.zephyr"
```

## prj.conf
```kconfig
CONFIG_USB_DEVICE_STACK_NEXT=y
CONFIG_SERIAL=y
CONFIG_UART_LINE_CTRL=y
CONFIG_USBD_CDC_ACM_CLASS=y
CONFIG_SAMPLE_USBD_PID=0x0001
CONFIG_SAMPLE_USBD_PRODUCT="mcu usb-cdc example"
```

## app.overlay
```dts
/* From zephyr samples/subsys/usb/cdc_acm/app.overlay: add a CDC ACM UART on the board's zephyr_udc0. */
&zephyr_udc0 {
	cdc_acm_uart0: cdc_acm_uart0 {
		compatible = "zephyr,cdc-acm-uart";
	};
};
```

## src/main.c
```c
#include <zephyr/kernel.h>
#include <zephyr/device.h>
#include <zephyr/drivers/uart.h>
#include <zephyr/usb/usbd.h>
#include <sample_usbd.h>

static const struct device *const cdc = DEVICE_DT_GET_ONE(zephyr_cdc_acm_uart);

int main(void)
{
	struct usbd_context *ctx = sample_usbd_init_device(NULL);
	if (ctx == NULL || usbd_enable(ctx) != 0 || !device_is_ready(cdc)) {
		return 0;
	}
	const char *hello = "usb-cdc up: type to echo\r\n";
	for (const char *p = hello; *p; p++) { uart_poll_out(cdc, *p); }
	while (1) {
		unsigned char c;
		if (uart_poll_in(cdc, &c) == 0) {
			uart_poll_out(cdc, c);
		} else {
			k_msleep(5);
		}
	}
}
```
