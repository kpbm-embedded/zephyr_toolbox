## CMakeLists.txt
```
cmake_minimum_required(VERSION 3.20.0)
find_package(Zephyr REQUIRED HINTS $ENV{ZEPHYR_BASE})
project(zbus_pubsub)
# channels + observers (src/bus.c) and the ztest suite that publishes and checks delivery (src/test_bus.c)
target_sources(app PRIVATE src/bus.c src/test_bus.c)
```

## prj.conf
```kconfig
CONFIG_ZTEST=y
CONFIG_ZBUS=y
# message subscribers get their own copy of every message (net_buf pool, static: no heap needed)
CONFIG_ZBUS_MSG_SUBSCRIBER=y
CONFIG_ZBUS_MSG_SUBSCRIBER_BUF_ALLOC_STATIC=y
CONFIG_ZBUS_MSG_SUBSCRIBER_NET_BUF_STATIC_DATA_SIZE=8
# observers added and removed at run time, nodes from a static pool
CONFIG_ZBUS_RUNTIME_OBSERVERS=y
CONFIG_ZBUS_RUNTIME_OBSERVERS_NODE_ALLOC_STATIC=y
CONFIG_ZBUS_RUNTIME_OBSERVERS_NODE_POOL_SIZE=2
CONFIG_ZBUS_CHANNEL_NAME=y
CONFIG_ZBUS_OBSERVER_NAME=y
```

## src/bus.c
```c
/* Channel and observers: a listener (callback), a subscriber (thread, notification only) and a
 * message subscriber (thread, own copy of each message). The validator rejects impossible values.
 */
#include <string.h>
#include "bus.h"

struct bus_stats bus_stats;
K_SEM_DEFINE(subscriber_sem, 0, 16);
K_SEM_DEFINE(msub_sem, 0, 16);

static bool temp_valid(const void *msg, size_t msg_size)
{
	const struct temp_msg *m = msg;

	ARG_UNUSED(msg_size);
	return m->mdeg >= -40000 && m->mdeg <= 150000;
}

static void listener_cb(const struct zbus_channel *chan)
{
	const struct temp_msg *m = zbus_chan_const_msg(chan); /* channel is locked during the callback */

	bus_stats.listener_last = *m;
	atomic_inc(&bus_stats.listener_calls);
}

ZBUS_LISTENER_DEFINE(temp_lis, listener_cb);
ZBUS_SUBSCRIBER_DEFINE(temp_sub, 4);
ZBUS_MSG_SUBSCRIBER_DEFINE(temp_msub);

ZBUS_CHAN_DEFINE(temp_chan, struct temp_msg, temp_valid, NULL,
		 ZBUS_OBSERVERS(temp_lis, temp_sub, temp_msub), ZBUS_MSG_INIT(.mdeg = 0, .seq = 0));

static void subscriber_thread(void *a, void *b, void *c)
{
	const struct zbus_channel *chan;

	while (zbus_sub_wait(&temp_sub, &chan, K_FOREVER) == 0) {
		struct temp_msg m;

		if (zbus_chan_read(chan, &m, K_MSEC(100)) == 0) {
			bus_stats.subscriber_last = m;
			atomic_inc(&bus_stats.subscriber_wakes);
			k_sem_give(&subscriber_sem);
		}
	}
}

static void msub_thread(void *a, void *b, void *c)
{
	const struct zbus_channel *chan;
	struct temp_msg m;

	while (zbus_sub_wait_msg(&temp_msub, &chan, &m, K_FOREVER) == 0) {
		atomic_val_t n = atomic_inc(&bus_stats.msub_msgs);

		if (n < (atomic_val_t)ARRAY_SIZE(bus_stats.msub_seen)) {
			bus_stats.msub_seen[n] = m;
		}
		k_sem_give(&msub_sem);
	}
}

K_THREAD_DEFINE(sub_tid, 1024, subscriber_thread, NULL, NULL, NULL, 5, 0, 0);
K_THREAD_DEFINE(msub_tid, 1024, msub_thread, NULL, NULL, NULL, 5, 0, 0);

void bus_reset_stats(void)
{
	memset(&bus_stats, 0, sizeof(bus_stats));
	k_sem_reset(&subscriber_sem);
	k_sem_reset(&msub_sem);
}
```

## src/bus.h
```c
#ifndef BUS_H
#define BUS_H

#include <zephyr/kernel.h>
#include <zephyr/zbus/zbus.h>

/* one sample of a temperature sensor, published on temp_chan */
struct temp_msg {
	int32_t mdeg; /* milli-degrees Celsius, valid -40000..150000 */
	uint32_t seq;
};

ZBUS_CHAN_DECLARE(temp_chan);
ZBUS_OBS_DECLARE(temp_lis);

/* what each kind of observer has seen (reset by bus_reset_stats) */
struct bus_stats {
	atomic_t listener_calls;  /* synchronous, in the publisher's context */
	atomic_t subscriber_wakes; /* thread, notified; reads the channel (may skip values) */
	atomic_t msub_msgs;       /* thread, gets a copy of every message */
	struct temp_msg listener_last;
	struct temp_msg subscriber_last;
	struct temp_msg msub_seen[8];
};

extern struct bus_stats bus_stats;
extern struct k_sem subscriber_sem;
extern struct k_sem msub_sem;

void bus_reset_stats(void);

#endif
```

## src/test_bus.c
```c
#include <zephyr/ztest.h>
#include "bus.h"

static void before(void *f)
{
	ARG_UNUSED(f);
	k_msleep(20); /* let the observer threads drain what the previous case published */
	bus_reset_stats();
}

ZTEST_SUITE(zbus_pubsub, NULL, NULL, before, NULL, NULL);

static int publish(int32_t mdeg, uint32_t seq)
{
	struct temp_msg m = {.mdeg = mdeg, .seq = seq};

	return zbus_chan_pub(&temp_chan, &m, K_MSEC(100));
}

ZTEST(zbus_pubsub, test_listener_runs_synchronously)
{
	zassert_ok(publish(21500, 1));
	/* no wait: listeners run inside zbus_chan_pub */
	zassert_equal(atomic_get(&bus_stats.listener_calls), 1);
	zassert_equal(bus_stats.listener_last.mdeg, 21500);
}

ZTEST(zbus_pubsub, test_subscriber_is_notified)
{
	zassert_ok(publish(22000, 2));
	zassert_ok(k_sem_take(&subscriber_sem, K_MSEC(500)), "subscriber not woken");
	zassert_equal(bus_stats.subscriber_last.seq, 2);
}

ZTEST(zbus_pubsub, test_msg_subscriber_gets_every_message)
{
	for (uint32_t i = 1; i <= 3; i++) {
		zassert_ok(publish(20000 + (int32_t)i, i));
	}
	for (int i = 0; i < 3; i++) {
		zassert_ok(k_sem_take(&msub_sem, K_MSEC(500)), "message %d missing", i);
	}
	/* each message is a copy taken at publish time, so all three values arrive in order */
	for (int i = 0; i < 3; i++) {
		zassert_equal(bus_stats.msub_seen[i].seq, (uint32_t)i + 1);
	}
}

ZTEST(zbus_pubsub, test_validator_rejects_bad_value)
{
	struct temp_msg now;

	zassert_ok(publish(25000, 7));
	zassert_equal(publish(400000, 8), -ENOMSG, "400 C must be rejected");
	zassert_ok(zbus_chan_read(&temp_chan, &now, K_MSEC(100)));
	zassert_equal(now.seq, 7, "rejected message must not reach the channel");
	zassert_equal(atomic_get(&bus_stats.listener_calls), 1);
}

static atomic_t extra_calls;
static void extra_cb(const struct zbus_channel *chan)
{
	ARG_UNUSED(chan);
	atomic_inc(&extra_calls);
}
ZBUS_LISTENER_DEFINE(extra_lis, extra_cb);

ZTEST(zbus_pubsub, test_runtime_observer_add_remove)
{
	atomic_clear(&extra_calls);
	zassert_ok(zbus_chan_add_obs(&temp_chan, &extra_lis, K_MSEC(100)));
	zassert_ok(publish(23000, 9));
	zassert_ok(zbus_chan_rm_obs(&temp_chan, &extra_lis, K_MSEC(100)));
	zassert_ok(publish(23001, 10));
	zassert_equal(atomic_get(&extra_calls), 1, "removed observer must not be called");
}

ZTEST(zbus_pubsub, test_channel_and_observer_names)
{
	zassert_str_equal(zbus_chan_name(&temp_chan), "temp_chan");
	zassert_str_equal(zbus_obs_name(&temp_lis), "temp_lis");
}
```
