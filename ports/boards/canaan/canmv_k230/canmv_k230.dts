/*
 * CanMV-K230 class boards (K230, 01Studio/Canaan), CPU0 - out-of-tree board of 32_03_zephyr/ports. See README.md here.
 * SPDX-License-Identifier: Apache-2.0
 */

/dts-v1/;

#include <riscv/canaan/k230.dtsi>
#include <zephyr/dt-bindings/gpio/gpio.h>

/ {
	model = "CanMV-K230 class boards (K230, 01Studio/Canaan), CPU0";
	compatible = "canaan,canmv-k230", "canaan,kendryte-k230";

	chosen {
		zephyr,console = &uart0;
		zephyr,shell-uart = &uart0;
		zephyr,sram = &ddr;
	};

	ddr: memory@0 {
		device_type = "memory";
		compatible = "mmio-sram";
		reg = <0x0 0x0 0x0 DT_SIZE_M(64)>;
	};
};

&uart0 {
	status = "okay";
	current-speed = <115200>;
};

