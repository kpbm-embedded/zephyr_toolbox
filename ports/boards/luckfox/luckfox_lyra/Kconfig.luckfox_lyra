## ports/boards/luckfox/luckfox_lyra/Kconfig.luckfox_lyra
```kconfig
# SPDX-License-Identifier: Apache-2.0
config BOARD_LUCKFOX_LYRA
	select SOC_RK3506
```

## ports/boards/luckfox/luckfox_lyra/board.yml
```yaml
board:
  name: luckfox_lyra
  full_name: Luckfox Lyra / Lyra Plus (RK3506G2)
  vendor: luckfox
  socs:
  - name: rk3506
```

## ports/boards/luckfox/luckfox_pico_mini/Kconfig.luckfox_pico_mini
```kconfig
# SPDX-License-Identifier: Apache-2.0
config BOARD_LUCKFOX_PICO_MINI
	select SOC_RV1106
```

## ports/boards/luckfox/luckfox_pico_mini/board.yml
```yaml
board:
  name: luckfox_pico_mini
  full_name: Luckfox Pico Mini A/B (RV1103)
  vendor: luckfox
  socs:
  - name: rv1106
```

## ports/boards/milkv/milkv_duo/Kconfig.milkv_duo
```kconfig
# SPDX-License-Identifier: Apache-2.0
config BOARD_MILKV_DUO
	select SOC_CV1800B
```

## ports/boards/milkv/milkv_duo/board.yml
```yaml
board:
  name: milkv_duo
  full_name: Milk-V Duo 64M (CV1800B), little C906 core
  vendor: milkv
  socs:
  - name: cv1800b
```

## ports/boards/sipeed/licheerv_nano/Kconfig.licheerv_nano
```kconfig
# SPDX-License-Identifier: Apache-2.0
config BOARD_LICHEERV_NANO
	select SOC_SG2002
```

## ports/boards/sipeed/licheerv_nano/board.yml
```yaml
board:
  name: licheerv_nano
  full_name: Sipeed LicheeRV Nano (SG2002), little C906 core
  vendor: sipeed
  socs:
  - name: sg2002
```

## ports/boards/widora/mangopi_mq_r/Kconfig.mangopi_mq_r
```kconfig
# SPDX-License-Identifier: Apache-2.0
config BOARD_MANGOPI_MQ_R
	select SOC_SUN8I_T113
```

## ports/boards/widora/mangopi_mq_r/board.yml
```yaml
board:
  name: mangopi_mq_r
  full_name: MangoPi MQ-R (T113-S3)
  vendor: widora
  socs:
  - name: sun8i_t113
```

## ports/boards/xunlong/opi_zero2/Kconfig.opi_zero2
```kconfig
# SPDX-License-Identifier: Apache-2.0
config BOARD_OPI_ZERO2
	select SOC_SUN50I_H616
```

## ports/boards/xunlong/opi_zero2/board.yml
```yaml
board:
  name: opi_zero2
  full_name: Orange Pi Zero2 (H616) / H616-H618 core boards
  vendor: xunlong
  socs:
  - name: sun50i_h616
```

## ports/drivers/Kconfig
```kconfig
# SPDX-License-Identifier: Apache-2.0
if GPIO
rsource "gpio/Kconfig"
endif
rsource "timer/Kconfig"
```

## ports/drivers/gpio/Kconfig
```kconfig
# SPDX-License-Identifier: Apache-2.0

config GPIO_ALLWINNER
	bool "Allwinner sunxi GPIO (backport of Zephyr main drivers/gpio/gpio_allwinner.c)"
	default y
	depends on DT_HAS_ALLWINNER_SUNXI_GPIO_ENABLED
	help
	  Allwinner PIO driver for H3, H616/H618 and T113 (D1 layout via
	  the allwinner,pull-offset property). Remove this copy when the
	  Zephyr tree is >= 4.5 (it ships the same driver).

config GPIO_ROCKCHIP_V2
	bool "Rockchip GPIO v2 (rockchip,gpio-bank)"
	default y
	depends on DT_HAS_ROCKCHIP_GPIO_BANK_ENABLED
	help
	  Minimal driver for the Rockchip GPIO v2 block (RV1106/RV1103,
	  RK3506, RK3568, RK3588): direction and data registers with
	  write-enable masks. No interrupts, no pinmux (pins must already be
	  in GPIO function, which is the reset default for most pins).
```

## ports/drivers/timer/Kconfig
```kconfig
# SPDX-License-Identifier: Apache-2.0

config THEAD_CLINT_TIMER
	bool "T-Head C9xx CLINT machine timer (mtime via time CSR)"
	default y
	depends on DT_HAS_THEAD_C900_CLINT_MTIMER_ENABLED
	select TICKLESS_CAPABLE
	select TIMER_HAS_64BIT_CYCLE_COUNTER
	help
	  System timer for T-Head C906/C908 (Sophgo CV18xx, Canaan K230):
	  the CLINT has mtimecmp (32-bit halves) but no memory-mapped mtime;
	  the counter is read with the time CSR. Derived from Zephyr's
	  riscv_machine_timer.c.
```

## ports/dts/bindings/cpu/canaan,k210.yaml
```yaml
# SPDX-License-Identifier: Apache-2.0
description: Canaan Kendryte K210 RV64GC core (privileged spec 1.9.1)

compatible: "canaan,k210"

include: riscv-common.yaml
```

## ports/dts/bindings/cpu/thead,c906.yaml
```yaml
# SPDX-License-Identifier: Apache-2.0
description: T-Head c906 RISC-V core

compatible: "thead,c906"

include: riscv-common.yaml
```

## ports/dts/bindings/cpu/thead,c908.yaml
```yaml
# SPDX-License-Identifier: Apache-2.0
description: T-Head c908 RISC-V core

compatible: "thead,c908"

include: riscv-common.yaml
```

## ports/dts/bindings/gpio/allwinner,sun50i-h616-gpio.yaml
```yaml
# SPDX-License-Identifier: Apache-2.0
description: "Allwinner sun50i-h616 GPIO bank, driver allwinner,sunxi-gpio"

compatible: "allwinner,sun50i-h616-gpio"

include: allwinner,sunxi-gpio.yaml
```

## ports/dts/bindings/gpio/allwinner,sun8i-h3-gpio.yaml
```yaml
# SPDX-License-Identifier: Apache-2.0
description: "Allwinner sun8i-h3 GPIO bank, driver allwinner,sunxi-gpio"

compatible: "allwinner,sun8i-h3-gpio"

include: allwinner,sunxi-gpio.yaml
```

## ports/dts/bindings/gpio/allwinner,sun8i-t113-gpio.yaml
```yaml
# SPDX-License-Identifier: Apache-2.0
description: "Allwinner sun8i-t113 GPIO bank, driver allwinner,sunxi-gpio"

compatible: "allwinner,sun8i-t113-gpio"

include: allwinner,sunxi-gpio.yaml
```

## ports/dts/bindings/gpio/allwinner,sunxi-gpio.yaml
```yaml
# Copyright (c) 2026 Khai Do
# SPDX-License-Identifier: Apache-2.0
# Backport from Zephyr main; added allwinner,pull-offset (32_03_zephyr ports/).

description: Allwinner sunxi GPIO controller

compatible: "allwinner,sunxi-gpio"

include: [gpio-controller.yaml, base.yaml]

properties:
  reg:
    required: true

  reg-names:
    required: true

  "#gpio-cells":
    const: 2

  allwinner,hw-bank:
    type: int
    required: true
    description: Hardware bank ID for the interrupts

  allwinner,pull-offset:
    type: int
    description: |
      Offset of the first pull register inside the bank: 0x1c on H3/H5/H616/H618
      (default), 0x24 on T113/D1 (banks 0x30 apart).

gpio-cells:
  - pin
  - flags
```

## ports/dts/bindings/gpio/rockchip,gpio-bank.yaml
```yaml
# SPDX-License-Identifier: Apache-2.0
description: |
  Rockchip GPIO v2 bank (RV1106/RV1103, RK3506, RK3568, RK3588). Driver:
  ports/drivers/gpio/gpio_rockchip_v2.c (output/input only, no pinmux, no IRQ).

compatible: "rockchip,gpio-bank"

include: [gpio-controller.yaml, base.yaml]

properties:
  reg:
    required: true

  "#gpio-cells":
    const: 2

gpio-cells:
  - pin
  - flags
```

## ports/dts/bindings/timer/thead,c900-clint-mtimer.yaml
```yaml
# SPDX-License-Identifier: Apache-2.0
description: |
  T-Head C906/C908 CLINT machine timer: mtimecmp registers (reg-names "mtimecmp",
  one 64-bit slot per hart, written as two 32-bit halves); mtime is read via the
  time CSR. Driver: ports/drivers/timer/thead_clint_timer.c.

compatible: "thead,c900-clint-mtimer"

include: base.yaml

properties:
  reg:
    required: true
  reg-names:
    required: true
  interrupts-extended:
    required: true
```
