## ports/soc/allwinner/sun50i_h616/Kconfig
```kconfig
# Copied from Zephyr main soc/allwinner/sun50i_h618 (Copyright (c) 2026 Khai Do); H616 = H618 core/peripherals.
# SPDX-License-Identifier: Apache-2.0
config SOC_SUN50I_H616
	select ARM64
	select CPU_CORTEX_A53
	select ARM_ARCH_TIMER
	select SYS_CLOCK_EXISTS
```

## ports/soc/allwinner/sun50i_h616/Kconfig.soc
```kconfig
# SPDX-License-Identifier: Apache-2.0
config SOC_SERIES_SUN50I
	bool

config SOC_SUN50I_H616
	bool
	select SOC_SERIES_SUN50I

config SOC_SERIES
	default "sun50i" if SOC_SERIES_SUN50I

config SOC
	default "sun50i_h616" if SOC_SUN50I_H616
```

## ports/soc/allwinner/sun8i_t113/Kconfig.defconfig
```kconfig
# SPDX-License-Identifier: Apache-2.0
if SOC_SUN8I_T113

config NUM_IRQS
	default 256

config SYS_CLOCK_HW_CYCLES_PER_SEC
	default $(dt_node_int_prop_int,/timer,clock-frequency)

configdefault UART_NS16550_DW8250_DW_APB
	default y

configdefault UART_NS16550_ACCESS_WORD_ONLY
	default y

endif # SOC_SUN8I_T113
```

## ports/soc/allwinner/sun8i_t113/Kconfig.soc
```kconfig
# SPDX-License-Identifier: Apache-2.0
config SOC_SERIES_SUN8IW20
	bool

config SOC_SUN8I_T113
	bool
	select SOC_SERIES_SUN8IW20

config SOC_SERIES
	default "sun8iw20" if SOC_SERIES_SUN8IW20

config SOC
	default "sun8i_t113" if SOC_SUN8I_T113
```

## ports/soc/canaan/k210/Kconfig
```kconfig
# SPDX-License-Identifier: Apache-2.0
config SOC_SERIES_K210
	select RISCV
	select RISCV_PRIVILEGED
	select RISCV_HAS_PLIC
	select 64BIT
	select RISCV_ISA_RV64I
	select RISCV_ISA_EXT_M
	select RISCV_ISA_EXT_A
	select RISCV_ISA_EXT_F
	select RISCV_ISA_EXT_D
	select RISCV_ISA_EXT_C
	select RISCV_ISA_EXT_ZICSR
	select RISCV_ISA_EXT_ZIFENCEI
	select INCLUDE_RESET_VECTOR
	select RISCV_SOC_HAS_GP_RELATIVE_ADDRESSING
	select ATOMIC_OPERATIONS_C
```

## ports/soc/canaan/k210/Kconfig.soc
```kconfig
# SPDX-License-Identifier: Apache-2.0
config SOC_SERIES_K210
	bool

config SOC_SERIES
	default "k210" if SOC_SERIES_K210

config SOC_K210
	bool
	select SOC_SERIES_K210

config SOC
	default "k210" if SOC_K210
```

## ports/soc/canaan/k230/Kconfig.soc
```kconfig
# SPDX-License-Identifier: Apache-2.0
config SOC_SERIES_K230
	bool

config SOC_SERIES
	default "k230" if SOC_SERIES_K230

config SOC_K230
	bool
	select SOC_SERIES_K230

config SOC
	default "k230" if SOC_K230
```

## ports/soc/rockchip/rk3506/Kconfig.defconfig
```kconfig
# SPDX-License-Identifier: Apache-2.0
if SOC_RK3506

config NUM_IRQS
	default 192

config SYS_CLOCK_HW_CYCLES_PER_SEC
	default $(dt_node_int_prop_int,/timer,clock-frequency)

configdefault UART_NS16550_DW8250_DW_APB
	default y

configdefault UART_NS16550_ACCESS_WORD_ONLY
	default y

endif # SOC_RK3506
```

## ports/soc/rockchip/rk3506/Kconfig.soc
```kconfig
# SPDX-License-Identifier: Apache-2.0
config SOC_SERIES_RK3506
	bool

config SOC_RK3506
	bool
	select SOC_SERIES_RK3506

config SOC_SERIES
	default "rk3506" if SOC_SERIES_RK3506

config SOC
	default "rk3506" if SOC_RK3506
```

## ports/soc/rockchip/rv1106/Kconfig.soc
```kconfig
# SPDX-License-Identifier: Apache-2.0
config SOC_SERIES_RV1106
	bool

config SOC_RV1106
	bool
	select SOC_SERIES_RV1106

config SOC_SERIES
	default "rv1106" if SOC_SERIES_RV1106

config SOC
	default "rv1106" if SOC_RV1106
```

## ports/soc/sophgo/cv18xx/Kconfig.soc
```kconfig
# SPDX-License-Identifier: Apache-2.0
config SOC_SERIES_CV18XX
	bool

config SOC_SERIES
	default "cv18xx" if SOC_SERIES_CV18XX

config SOC_CV1800B
	bool
	select SOC_SERIES_CV18XX

config SOC
	default "cv1800b" if SOC_CV1800B

config SOC_SG2002
	bool
	select SOC_SERIES_CV18XX

config SOC
	default "sg2002" if SOC_SG2002
```
